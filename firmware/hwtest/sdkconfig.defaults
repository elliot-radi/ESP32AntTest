## firmware/hwtest/sdkconfig.defaults
```kconfig
# hwtest sdkconfig defaults — C3 board bring-up (no custom partition table)
CONFIG_ESPTOOLPY_FLASHSIZE_4MB=y
```

## firmware/mobile/sdkconfig.defaults
```kconfig
# Mobile sdkconfig defaults — Config A is ESP32-C3 (native USB JTAG/serial).
# Minimal partition table: nvs + phy + factory only (no LittleFS on Mobile).
CONFIG_PARTITION_TABLE_SINGLE_APP=y
CONFIG_ESPTOOLPY_FLASHSIZE_4MB=y

# C3 native USB serial/JTAG console (ttyACM*).
CONFIG_ESP_CONSOLE_USB_SERIAL_JTAG=y
```

## firmware/station/sdkconfig.defaults
```kconfig
# Station sdkconfig defaults — applied by `idf.py set-target`.
# Custom partition table (4 MB flash, no OTA, 1 MB LittleFS logs).
# See firmware/station/partitions.csv and SPEC §7/§8.
CONFIG_PARTITION_TABLE_CUSTOM=y
CONFIG_PARTITION_TABLE_CUSTOM_FILENAME="partitions.csv"

# 4 MB flash (dev modules); the default is 2 MB which is too small for our
# partition layout.
CONFIG_ESPTOOLPY_FLASHSIZE_4MB=y

# Station is a SoftAP with no uplink; we don't need the default station WiFi
# config that tries to join an SSID. (WiFi init is stubbed in this skeleton.)
```
